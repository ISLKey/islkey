/**
 * Provision.cpp — WiFi AP provisioning web server
 * Serves config page at 192.168.4.1 when no config exists
 */

#include "Provision.h"
#include "Config.h"
#include "LED.h"
#include "Commission.h"
#include "Display.h"
#include "BLE.h"
#include <WiFi.h>
#include <WebServer.h>
#include <ArduinoJson.h>

namespace Provision {

    static WebServer server(80);

    // ── HTML provisioning page ─────────────────────────────────────────────────
    const char PROVISION_HTML[] PROGMEM = R"rawhtml(
<!DOCTYPE html>
<html lang="en">
<head>
<meta charset="UTF-8">
<meta name="viewport" content="width=device-width,initial-scale=1">
<title>ISLKey Setup</title>
<style>
  *{box-sizing:border-box;margin:0;padding:0}
  body{font-family:-apple-system,BlinkMacSystemFont,'Segoe UI',sans-serif;background:#0d1117;color:#e6edf3;min-height:100vh;padding:20px}
  .wrap{max-width:520px;margin:0 auto}
  .header{background:#161b22;border:1px solid #30363d;border-radius:12px;padding:24px;margin-bottom:20px;text-align:center}
  .logo{font-size:28px;font-weight:700;color:#58a6ff;letter-spacing:0.04em}
  .subtitle{font-size:13px;color:#8b949e;margin-top:6px}
  .card{background:#161b22;border:1px solid #30363d;border-radius:12px;padding:20px;margin-bottom:16px}
  .card h2{font-size:13px;font-weight:600;text-transform:uppercase;letter-spacing:0.08em;color:#8b949e;margin-bottom:16px;padding-bottom:10px;border-bottom:1px solid #30363d}
  .field{margin-bottom:14px}
  label{display:block;font-size:13px;font-weight:500;color:#c9d1d9;margin-bottom:6px}
  input,select{width:100%;padding:10px 12px;background:#0d1117;border:1px solid #30363d;border-radius:8px;color:#e6edf3;font-size:14px;outline:none;transition:border-color 0.2s}
  input:focus,select:focus{border-color:#58a6ff}
  select option{background:#161b22}
  .row{display:grid;grid-template-columns:1fr 1fr;gap:12px}
  .hint{font-size:11px;color:#6e7681;margin-top:4px}
  .btn{display:block;width:100%;padding:14px;background:#238636;border:none;border-radius:8px;color:#fff;font-size:15px;font-weight:600;cursor:pointer;transition:background 0.2s;margin-top:8px}
  .btn:hover{background:#2ea043}
  .status{display:none;padding:12px 16px;border-radius:8px;font-size:13px;margin-bottom:16px;text-align:center}
  .status.ok{background:#0d4a1a;border:1px solid #238636;color:#56d364;display:block}
  .status.err{background:#3d1214;border:1px solid #f85149;color:#ff7b72;display:block}
  .mac{font-family:monospace;font-size:12px;color:#58a6ff;text-align:center;margin-top:8px}
</style>
</head>
<body>
<div class="wrap">
  <div class="header">
    <div class="logo">ISLKey</div>
    <div class="subtitle">Door Controller Setup</div>
    <div class="mac" id="mac-addr">Loading...</div>
  </div>

  <div id="status-msg" class="status"></div>

  <!-- Network -->
  <div class="card">
    <h2>Network</h2>
    <div class="field">
      <label>WiFi Network (SSID)</label>
      <input type="text" id="wifi_ssid" placeholder="YourNetworkName" autocomplete="off">
    </div>
    <div class="field">
      <label>WiFi Password</label>
      <input type="password" id="wifi_password" placeholder="••••••••">
    </div>
    <div class="field">
      <label>ISLKey API URL</label>
      <input type="url" id="api_url" placeholder="https://yourdomain.co.uk">
      <div class="hint">Your WordPress site URL — no trailing slash</div>
    </div>
    <div class="field">
      <label>Device API Token</label>
      <input type="text" id="api_token" placeholder="Paste token from ISLKey admin" autocomplete="off">
    </div>
  </div>

  <!-- Device Identity -->
  <div class="card">
    <h2>Device Identity</h2>
    <div class="row">
      <div class="field">
        <label>Door Name</label>
        <input type="text" id="door_name" placeholder="Main Entrance">
      </div>
      <div class="field">
        <label>Site Code</label>
        <input type="text" id="site_code" placeholder="SITE001" style="text-transform:uppercase">
      </div>
    </div>
  </div>

  <!-- Security Inputs -->
  <div class="card">
    <h2>Security Inputs</h2>
    <div id="inputs-config">
      <!-- Generated by JS -->
    </div>
  </div>

  <!-- Relay Outputs -->
  <div class="card">
    <h2>Relay Outputs</h2>
    <div id="relays-config">
      <!-- Generated by JS -->
    </div>
  </div>

  <!-- Door Behaviour -->
  <div class="card">
    <h2>Door Behaviour</h2>
    <div class="row">
      <div class="field">
        <label>Held Open Alert (seconds)</label>
        <input type="number" id="held_open_secs" value="60" min="10" max="600">
        <div class="hint">Alert if door open longer than this</div>
      </div>
      <div class="field">
        <label>Forced Entry Detection</label>
        <select id="forced_entry">
          <option value="1">Enabled</option>
          <option value="0">Disabled</option>
        </select>
        <div class="hint">Alert if door opens without valid access</div>
      </div>
    </div>
  </div>

  <button class="btn" onclick="saveConfig()">Save &amp; Restart</button>
</div>

<script>
const inputFunctions = ['Disabled','Exit Button','Door Contact','Fire Alarm','Tamper'];
const inputLogics    = ['NC (Normally Closed)','NO (Normally Open)'];
const relayFunctions = ['Disabled','Primary Lock','Secondary Relay','Alarm Output'];

// Build input rows
const inputsDiv = document.getElementById('inputs-config');
for(let i=0;i<4;i++){
  inputsDiv.innerHTML += `
  <div style="margin-bottom:14px;padding-bottom:14px;border-bottom:1px solid #21262d">
    <div style="font-size:12px;font-weight:600;color:#58a6ff;margin-bottom:8px">Input ${i+1}</div>
    <div class="row">
      <div class="field">
        <label>Function</label>
        <select id="in${i}_fn">
          ${inputFunctions.map((f,j)=>`<option value="${j}" ${j==i+1?'selected':''}>${f}</option>`).join('')}
        </select>
      </div>
      <div class="field">
        <label>Logic</label>
        <select id="in${i}_lg">
          ${inputLogics.map((l,j)=>`<option value="${j}" ${(i==0)?j==1?'selected':'':j==0?'selected':''?'selected':''}>${l}</option>`).join('')}
        </select>
      </div>
    </div>
  </div>`;
}

// Build relay rows
const relaysDiv = document.getElementById('relays-config');
for(let i=0;i<2;i++){
  relaysDiv.innerHTML += `
  <div style="margin-bottom:14px;padding-bottom:14px;border-bottom:1px solid #21262d">
    <div style="font-size:12px;font-weight:600;color:#58a6ff;margin-bottom:8px">Relay ${i+1}</div>
    <div class="row">
      <div class="field">
        <label>Function</label>
        <select id="rl${i}_fn">
          ${relayFunctions.map((f,j)=>`<option value="${j}" ${j==(i==0?1:0)?'selected':''}>${f}</option>`).join('')}
        </select>
      </div>
      <div class="field">
        <label>Pulse Duration (ms)</label>
        <input type="number" id="rl${i}_ms" value="${i==0?5000:2000}" min="500" max="30000" step="500">
        <div class="hint">How long relay stays energised</div>
      </div>
    </div>
    <div class="field">
      <label>Polarity</label>
      <select id="rl${i}_ah">
        <option value="1">Active HIGH (relay energises on HIGH)</option>
        <option value="0">Active LOW (relay energises on LOW)</option>
      </select>
    </div>
  </div>`;
}

// Load device info
fetch('/info').then(r=>r.json()).then(d=>{
  document.getElementById('mac-addr').textContent = 'MAC: ' + d.mac;
  if(d.door_name) document.getElementById('door_name').value = d.door_name;
  if(d.site_code) document.getElementById('site_code').value = d.site_code;
  if(d.api_url)   document.getElementById('api_url').value   = d.api_url;
  if(d.api_token) document.getElementById('api_token').value = d.api_token;
});

function val(id){ return document.getElementById(id).value; }

async function saveConfig(){
  const payload = {
    wifi_ssid:     val('wifi_ssid'),
    wifi_password: val('wifi_password'),
    api_url:       val('api_url').replace(/\/$/,''),
    api_token:     val('api_token'),
    door_name:     val('door_name'),
    site_code:     val('site_code').toUpperCase(),
    held_open_secs: parseInt(val('held_open_secs')),
    forced_entry:  parseInt(val('forced_entry')),
    inputs: [],
    relays: []
  };

  for(let i=0;i<4;i++){
    payload.inputs.push({
      function: parseInt(val('in'+i+'_fn')),
      logic:    parseInt(val('in'+i+'_lg'))
    });
  }
  for(let i=0;i<2;i++){
    payload.relays.push({
      function:    parseInt(val('rl'+i+'_fn')),
      pulse_ms:    parseInt(val('rl'+i+'_ms')),
      active_high: parseInt(val('rl'+i+'_ah')) === 1
    });
  }

  if(!payload.wifi_ssid){ showStatus('Please enter your WiFi network name','err'); return; }

  const btn = document.querySelector('.btn');
  btn.textContent = 'Saving...';
  btn.disabled = true;

  try {
    const res = await fetch('/save', {
      method:'POST',
      headers:{'Content-Type':'application/json'},
      body: JSON.stringify(payload)
    });
    const data = await res.json();
    if(data.ok){
      showStatus('Saved! Device is restarting and will join your WiFi network...','ok');
      btn.textContent = 'Restarting...';
    } else {
      showStatus('Save failed: ' + (data.error||'unknown error'),'err');
      btn.textContent = 'Save & Restart';
      btn.disabled = false;
    }
  } catch(e) {
    showStatus('Connection error — try again','err');
    btn.textContent = 'Save & Restart';
    btn.disabled = false;
  }
}

function showStatus(msg, type){
  const el = document.getElementById('status-msg');
  el.textContent = msg;
  el.className = 'status ' + type;
  el.scrollIntoView({behavior:'smooth'});
}
</script>
</body>
</html>
)rawhtml";

    // ── Route handlers ─────────────────────────────────────────────────────────

    void handleRoot() {
        server.send( 200, "text/html", PROVISION_HTML );
    }

    void handleInfo() {
        uint8_t mac[6];
        esp_read_mac( mac, ESP_MAC_WIFI_STA );
        char macStr[18];
        snprintf( macStr, 18, "%02X:%02X:%02X:%02X:%02X:%02X",
            mac[0], mac[1], mac[2], mac[3], mac[4], mac[5] );

        StaticJsonDocument<512> doc;
        doc["mac"]       = macStr;
        doc["door_name"] = Config::device.door_name;
        doc["site_code"] = Config::device.site_code;
        doc["api_url"]   = Config::network.api_url;     // pre-loaded from .islkey
        doc["api_token"] = Config::network.api_token;   // pre-loaded from .islkey

        String out;
        serializeJson( doc, out );
        server.send( 200, "application/json", out );
    }

    void handleSave() {
        if ( !server.hasArg("plain") ) {
            server.send( 400, "application/json", "{\"ok\":false,\"error\":\"no body\"}" );
            return;
        }

        StaticJsonDocument<1024> doc;
        DeserializationError err = deserializeJson( doc, server.arg("plain") );
        if ( err ) {
            server.send( 400, "application/json", "{\"ok\":false,\"error\":\"bad json\"}" );
            return;
        }

        // Apply network config
        Config::setNetwork(
            doc["wifi_ssid"]     | "",
            doc["wifi_password"] | "",
            doc["api_url"]       | "",
            doc["api_token"]     | ""
        );

        // Apply device identity
        Config::setDevice(
            doc["door_name"] | "Door",
            doc["site_code"] | ""
        );

        // Apply door behaviour
        Config::setDoor(
            doc["held_open_secs"] | 60,
            ( doc["forced_entry"] | 1 ) == 1
        );

        // Apply inputs
        JsonArray inputs = doc["inputs"].as<JsonArray>();
        for ( int i = 0; i < 4 && i < (int)inputs.size(); i++ ) {
            Config::setInput( i,
                (InputFunction)( inputs[i]["function"] | 0 ),
                (InputLogic)(    inputs[i]["logic"]    | 0 )
            );
        }

        // Apply relays
        JsonArray relays = doc["relays"].as<JsonArray>();
        for ( int i = 0; i < 2 && i < (int)relays.size(); i++ ) {
            Config::setRelay( i,
                (RelayFunction)( relays[i]["function"]    | 0 ),
                (uint16_t)(      relays[i]["pulse_ms"]    | 5000 ),
                (bool)(          relays[i]["active_high"] | true )
            );
        }

        // Save to NVS
        Config::save();

        server.send( 200, "application/json", "{\"ok\":true}" );

        // Restart after short delay so response is sent
        delay( 1500 );
        ESP.restart();
    }

    void handleNotFound() {
        server.sendHeader( "Location", "/", true );
        server.send( 302, "text/plain", "" );
    }

    // ── AP startup ─────────────────────────────────────────────────────────────
    void startAP() {
        // Build AP name from MAC
        uint8_t mac[6];
        esp_read_mac( mac, ESP_MAC_WIFI_STA );
        char apName[20];
        snprintf( apName, 20, "ISLKey-%02X%02X", mac[4], mac[5] );

        // Secure the setup AP with the commissioned password if we have one
        bool secured = strlen( Config::device.ap_pwd ) >= 8;
        Serial.printf("[PROV] Starting AP: %s (%s)\n", apName, secured ? "secured" : "open" );
        WiFi.mode( WIFI_AP );
        if ( secured ) WiFi.softAP( apName, Config::device.ap_pwd );
        else           WiFi.softAP( apName );

        Serial.printf("[PROV] AP IP: %s\n", WiFi.softAPIP().toString().c_str() );
        Serial.println("[PROV] Open browser to http://192.168.4.1");

        server.on( "/",     HTTP_GET,  handleRoot  );
        server.on( "/info", HTTP_GET,  handleInfo  );
        server.on( "/save", HTTP_POST, handleSave  );
        server.onNotFound( handleNotFound );
        server.begin();

        LED::set( LED::WHITE, LED::BLINK_SLOW );

#ifdef BOARD_TTGO
        // Show setup details on-screen so the installer can read the AP password
        Display::setProvisioning( true, apName );
        Display::setIdentity( Config::device.serial, Config::device.ap_pwd, Config::device.site_code );
        Display::setDoorName( Config::device.door_name );
#endif

        // Block here — handle clients until config saved and restart triggered.
        // Still service commissioning + display so identity can be set/seen here.
        Serial.println("[PROV] Waiting for configuration (browser or app)...");
        while ( true ) {
            server.handleClient();
            Commission::poll();
            BLE::loop();          // service app provisioning + scheduled restart
#ifdef BOARD_TTGO
            Display::loop();
#endif
            delay( 2 );
        }
    }
}
